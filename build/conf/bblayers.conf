## build/conf/bblayers.conf
```bitbake
# POKY_BBLAYERS_CONF_VERSION is increased each time build/conf/bblayers.conf
# changes incompatibly
POKY_BBLAYERS_CONF_VERSION = "2"

BBPATH = "${TOPDIR}"
BBFILES ?= ""

BBLAYERS ?= " \
  /home/sahkhan/Yocto_Tutorial/poky/meta \
  /home/sahkhan/Yocto_Tutorial/poky/meta-poky \
  /home/sahkhan/Yocto_Tutorial/poky/meta-yocto-bsp \
  /home/sahkhan/Yocto_Tutorial/poky/meta-mylayer \
  "
```
